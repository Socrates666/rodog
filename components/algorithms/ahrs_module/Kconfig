## components/algorithms/ahrs_module/Kconfig
```kconfig
menu "AHRS Module"

config AHRS_MODULE_ENABLE
    bool "Enable AHRS module"
    default y
    help
        Enable or disable AHRS algorithm module build.

if AHRS_MODULE_ENABLE

config AHRS_USE_MAG
    bool "Enable magnetometer processing"
    default y
    help
        Enable magnetometer calibration and data path.

config AHRS_FILTER_MADGWICK
    bool "Use Madgwick filter"
    default y
    help
        Enable Madgwick attitude estimation.

config AHRS_ENABLE_PIPELINE
    bool "Enable optional AHRS pipeline"
    default n
    help
        Enable internal periodic processing pipeline.

config AHRS_PIPELINE_USE_FREERTOS
    bool "AHRS pipeline backend uses FreeRTOS"
    depends on AHRS_ENABLE_PIPELINE
    default n

config AHRS_DEFAULT_SAMPLE_RATE_HZ
    int "Default sample rate (Hz)"
    range 1 2000
    default 200

config AHRS_DEFAULT_MADGWICK_BETA
    int "Default Madgwick beta (x1000)"
    range 1 5000
    default 80
    help
        Madgwick beta scaled by 1000.
        Example: 80 = 0.080, 100 = 0.100.

endif

endmenu
```

## main/Kconfig.projbuild
```kconfig
menu "Communication settings"

    choice COMM_WEBSERVER_WIFI_MODE
        prompt "WebServer WiFi mode"
        default COMM_WEBSERVER_WIFI_MODE_AP
        help
            Select the WiFi mode used by web server at boot.

        config COMM_WEBSERVER_WIFI_MODE_AP
            bool "AP"
            help
                Start WiFi in Access Point (AP) mode.

        config COMM_WEBSERVER_WIFI_MODE_STA
            bool "STA"
            help
                Start WiFi in Station (STA) mode.

    endchoice

    config COMM_WEBSERVER_AP_SSID
        string "AP SSID"
        default "WAVESHARE Robot"
        help
            SSID used when WebServer starts in AP mode.

    config COMM_WEBSERVER_AP_PASSWORD
        string "AP password"
        default "1234567890"
        help
            Password used when WebServer starts in AP mode.
            Leave empty for open AP.

    config COMM_WEBSERVER_STA_SSID
        string "STA SSID"
        default "OnePlus 8"
        help
            SSID used when WebServer starts in STA mode.

    config COMM_WEBSERVER_STA_PASSWORD
        string "STA password"
        default "40963840"
        help
            Password used when WebServer starts in STA mode.

    config COMM_MICRO_ROS_UART_ENABLE
        bool "Enable micro-ROS UART module"
        default n
        help
            Enable micro-ROS node over UART for servo control.

    config COMM_MICRO_ROS_UART_PORT
        int "micro-ROS UART port"
        default 0
        range 0 2
        depends on COMM_MICRO_ROS_UART_ENABLE
        help
            UART port number (0-2) for micro-ROS transport.

    config COMM_MICRO_ROS_UART_BAUD
        int "micro-ROS UART baud rate"
        default 115200
        depends on COMM_MICRO_ROS_UART_ENABLE
        help
            UART baud rate for micro-ROS transport.

    config COMM_MICRO_ROS_UART_RX_BUFFER
        int "micro-ROS UART RX buffer size"
        default 1024
        depends on COMM_MICRO_ROS_UART_ENABLE
        help
            UART driver RX buffer size.

    config COMM_MICRO_ROS_UART_TX_BUFFER
        int "micro-ROS UART TX buffer size"
        default 0
        depends on COMM_MICRO_ROS_UART_ENABLE
        help
            UART driver TX buffer size.

    config COMM_MICRO_ROS_NODE_NAME
        string "micro-ROS node name"
        default "rodog_uart_node"
        depends on COMM_MICRO_ROS_UART_ENABLE
        help
            micro-ROS node name for UART transport.

    config COMM_MICRO_ROS_SERVO_TOPIC
        string "micro-ROS servo command topic"
        default "/rodog/servo_cmd"
        depends on COMM_MICRO_ROS_UART_ENABLE
        help
            Topic name for servo command subscription.

endmenu

source "../components/algorithms/ahrs_module/Kconfig"

menu "Control settings"

    config CONTROL_CALIBRATION_ENABLE
        bool "Enable servo calibration from NVS"
        default y
        help
            When enabled, servo middle positions are loaded from NVS and updates
            are persisted. When disabled, built-in defaults are used and no NVS
            writes occur.

    config CONTROL_SERVO_FREQ_HZ
        int "Servo PWM frequency (Hz)"
        default 50
        range 40 300
        help
            PWM frequency used for PCA9685 servo control. Keep at 50 Hz for
            standard RC servos unless you know the hardware supports higher
            rates.

endmenu
```

## sdkconfig.defaults
```kconfig
# Default SDK configuration for WaveGo Display

# FreeRTOS configuration
CONFIG_FREERTOS_UNICORE=n
CONFIG_FREERTOS_HZ=100

# Logging
CONFIG_LOG_DEFAULT_LEVEL_INFO=y
CONFIG_LOG_TIMESTAMP_SOURCE_RTOS=y

# I2C configuration
CONFIG_I2C_MASTER_FREQ_HZ=400000

# OLED display
CONFIG_I2C_MASTER_SCL_IO=22
CONFIG_I2C_MASTER_SDA_IO=21

# WiFi configuration (for IP display)
CONFIG_ESP_WIFI_STA_AUTOCONNECT=y
CONFIG_ESP_WIFI_SOFTAP_SUPPORT=n
CONFIG_ESP_WIFI_SSID="YourWiFiSSID"
CONFIG_ESP_WIFI_PASSWORD="YourWiFiPassword"

# Networking
CONFIG_LWIP_DHCP_DOES_ARP_CHECK=y

# NVS configuration
CONFIG_NVS_ENCRYPTION=n

# Component manager
CONFIG_COMPILER_OPTIMIZATION_PERF=y
```
